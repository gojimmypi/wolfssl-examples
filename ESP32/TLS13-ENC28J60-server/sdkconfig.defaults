## ESP32/TLS13-ENC28J60-server/sdkconfig.defaults
```kconfig
CONFIG_ESP_NETIF_TCPIP_ADAPTER_COMPATIBLE_LAYER=n

#
# Example Configuration
#
CONFIG_EXAMPLE_GPIO_RANGE_MIN=0
CONFIG_EXAMPLE_GPIO_RANGE_MAX=33
CONFIG_EXAMPLE_ENC28J60_SPI_HOST=1
CONFIG_EXAMPLE_ENC28J60_SCLK_GPIO=19
CONFIG_EXAMPLE_ENC28J60_MOSI_GPIO=23
CONFIG_EXAMPLE_ENC28J60_MISO_GPIO=25
CONFIG_EXAMPLE_ENC28J60_CS_GPIO=22
CONFIG_EXAMPLE_ENC28J60_SPI_CLOCK_MHZ=6
CONFIG_EXAMPLE_ENC28J60_INT_GPIO=4
# CONFIG_EXAMPLE_ENC28J60_DUPLEX_FULL is not set
CONFIG_EXAMPLE_ENC28J60_DUPLEX_HALF=y
# end of Example Configuration
```
